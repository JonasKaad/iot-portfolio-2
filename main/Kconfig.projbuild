## main/Kconfig.projbuild
```kconfig
menu "Portfolio 2 Config"

    config MQTT_BROKER
        string "Broker URL"
        default "mqtt://hosting.alexandernorup.com"
        help
            URL of the broker to connect to

    config MQTT_COMMAND_TOPIC
        string "Command topic"
        default "loweffortcommandtopic"
        
    config MQTT_RESPONSE_TOPIC
        string "Response topic"
        default "loweffortresponsetopic"

    config WIFI_SSID
        string "Wifi SSID"
        default "loweffortwifi"
        
    config WIFI_PASSWORD
        string "Wifi Password"
        default "loweffortpassword"
    

endmenu
```
